# C2000_eCAP_Type0_Registers register map
Vendor: Texas Instruments
Peripheral module from a debugger description file (folder C2000).
Address unit: 16 bits
Registers are 32-bit, access not given, no defined reset value unless marked. A register's access mark holds for its fields unless they carry their own. Offsets are as the file gives them; lines under a group give offsets from that group; [hi:lo] are bit positions; {n}, {i} and the like mark numbered series; 'fields as' and 'values as' point back to an identical list; <NAME> marks a mode.

## ECAP — eCAP Control and Status Registers
0x00 TSCTR — eCAP Time-Stamp Counter
0x02 CTRPHS — eCAP Counter Phase Offset Value Register
{0x2+2i} CAP{i} (i=1..4) — eCAP Capture {i} Register
0x14 ECCTL1 16-bit — eCAP Capture Control Register 1
0x15 ECCTL2 16-bit — eCAP Capture Control Register 2
0x16 ECEINT 16-bit — eCAP Capture Interrupt Enable Register
0x17 ECFLG 16-bit — eCAP Capture Interrupt Flag Register
0x18 ECCLR 16-bit — eCAP Capture Interrupt Clear Register
0x19 ECFRC 16-bit — eCAP Capture Interrupt Force Register
