# 28M35x_M3_DCSM_Registers register map
Vendor: Texas Instruments
Peripheral module from a debugger description file (folder C2000).
Address unit: 16 bits
Registers are 32-bit, access not given, no defined reset value unless marked. A register's access mark holds for its fields unless they carry their own. Offsets are as the file gives them; lines under a group give offsets from that group; [hi:lo] are bit positions; {n}, {i} and the like mark numbered series; 'fields as' and 'values as' point back to an identical list; <NAME> marks a mode.

## DCSM_REGS — DCSM REGS Registers
{0x0+4i} Z1_CSMKEY{i} (i=0..3) — CSMKEY Register for M3-Zone-1 security Zone
0x10 Z1_ECSLKEY0 — ECSLKEY Register for M3-Zone-1 security Zone
0x14 Z1_ECSLKEY1 — ECSLKEY Register for M3-Zone-1 security Zone
{0x18+4i} Z2_CSMKEY{i} (i=0..3) — CSMKEY Register for M3-Zone-2 security Zone
0x28 Z2_ECSLKEY0 — ECSLKEY Register for M3-Zone-2 security Zone
0x2C Z2_ECSLKEY1 — ECSLKEY Register for M3-Zone-2 security Zone
0x60 Z1_CSMLOCKSR — Locked Status Register for CSM passwords of M3-Zone-1 security Zone
0x64 Z1_ECSLLOCKSR — Locked Status Register for ECSL passwords of M3-Zone-1 security Zone
0x68 Z2_CSMLOCKSR — Locked Status Register for CSM passwords of M3-Zone-2 security Zone
0x6C Z2_ECSLLOCKSR — Locked Status Register for ECSL passwords of M3-Zone-2 security Zone
0x80 Z1_CR — Status and Control Register for M3-Zone-1 security Zone
0x84 Z2_CR — Status and Control Register for M3-Zone-2 security Zone
0x90 Z1_GRABSECTR — Grab Flash-Sectors Register for M3-Zone-1 security Zone
0x94 Z1_GRABRAMR — Grab RAM-blocks Register for M3-Zone-1 security Zone
0x98 Z2_GRABSECTR — Grab Flash-Sectors Register for M3-Zone-2 security Zone
0x9C Z2_GRABRAMR — Grab RAM-blocks Register for M3-Zone-2 security Zone
0xB0 Z1_EXEONLYR — Execute-Only Select Register for flash sectors mapped to M3-Zone-1 security Zone
0xB4 Z2_EXEONLYR — Execute-Only Select Register for flash sectors mapped to M3-Zone-2 security Zone
