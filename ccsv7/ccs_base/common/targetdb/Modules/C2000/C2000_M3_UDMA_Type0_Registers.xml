# C2000_M3_UDMA_Type0_Registers register map
Vendor: Texas Instruments
Peripheral module from a debugger description file (folder C2000).
Address unit: 16 bits
Registers are 32-bit, access not given, no defined reset value unless marked. A register's access mark holds for its fields unless they carry their own. Offsets are as the file gives them; lines under a group give offsets from that group; [hi:lo] are bit positions; {n}, {i} and the like mark numbered series; 'fields as' and 'values as' point back to an identical list; <NAME> marks a mode.

## UDMA_REGS — UDMA REGS Registers
0x00 DMASTAT — DMA Status
0x04 DMACFG — DMA Configuration
0x08 DMACTLBASE — DMA Channel Control Base Pointer
0x0C DMAALTBASE — DMA Alternate Channel Control Base Pointer
0x10 DMAWAITSTAT — DMA Channel Wait-on-Request Status
0x14 DMASWREQ — DMA Channel Software Request
0x18 DMAUSEBURSTSET — DMA Channel Useburst Set
0x1C DMAUSEBURSTCLR — DMA Channel Useburst Clear
0x20 DMAREQMASKSET — DMA Channel Request Mask Set
0x24 DMAREQMASKCLR — DMA Channel Request Mask Clear
0x28 DMAENASET — DMA Channel Enable Set
0x2C DMAENACLR — DMA Channel Enable Clear
0x30 DMAALTSET — DMA Channel Primary Alternate Set
0x34 DMAALTCLR — DMA Channel Primary Alternate Clear 290
0x38 DMAPRIOSET — DMA Channel Priority Set
0x3C DMAPRIOCLR — DMA Channel Priority Clear
0x4C DMAERRCLR — DMA Bus Error Clear
0x500 DMACHALTL — DMA Channel Alternate Select
{0x510+4i} DMACHMAP{i} (i=0..3) — DMA Channel Map Select {i}
