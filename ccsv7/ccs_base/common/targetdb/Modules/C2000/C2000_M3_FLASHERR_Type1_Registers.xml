# C2000_M3_FLASHERR_Type1_Registers register map
Vendor: Texas Instruments
Peripheral module from a debugger description file (folder C2000).
Address unit: 16 bits
Registers are 32-bit, access not given, no defined reset value unless marked. A register's access mark holds for its fields unless they carry their own. Offsets are as the file gives them; lines under a group give offsets from that group; [hi:lo] are bit positions; {n}, {i} and the like mark numbered series; 'fields as' and 'values as' point back to an identical list; <NAME> marks a mode.

## FLASH_ERR_REGS — FLASH ERR REGS Registers
0x00 ECC_ENABLE
0x04 SINGLE_ERR_ADDR — Single Error Address Register
0x08 UNC_ERR_ADDR — Uncorrectable Error Address Register
0x0C ERR_STATUS — Error Status Register
0x10 ERR_POS — Error Position Register
0x14 ERR_STATUS_CLR — Error Status Clear Register
0x18 ERR_CNT — Error Count Register
0x1C ERR_THRESHOLD — Error Threshold Register
0x20 ERR_INTFLG — Error Interrupt Flag Register
0x24 ERR_INTCLR — Error Interrupt Clear Register
0x28 FDATAH_TEST — Test Data High Register
0x2C FDATAL_TEST — Test Data Low Register
0x30 FADDR_TEST — Test Data Address Register
0x34 FECC_TEST — Test Data ECC Register
0x38 FECC_CTRL — ECC Test Control Register
0x3C FECC_FOUTH_TEST — Test Data Out High Register
0x40 FECC_FOUTL_TEST — Test Data Out Low Register
0x44 FECC_STATUS — Test Status Register
