# 28x3x_Device_Emulation_Registers register map
Vendor: Texas Instruments
Peripheral module from a debugger description file (folder C2000).
Address unit: 16 bits
Registers are 16-bit, access not given, no defined reset value unless marked. A register's access mark holds for its fields unless they carry their own. Offsets are as the file gives them; lines under a group give offsets from that group; [hi:lo] are bit positions; {n}, {i} and the like mark numbered series; 'fields as' and 'values as' point back to an identical list; <NAME> marks a mode.

## DEVEMU — Device Emulation Registers
0x00 DEVICECNF 32-bit — Device Configuration Register
0x02 CLASSID
0x03 REVID — Revision ID Register
0x04 PROTSTART — Block Protection Start Address Register
0x05 PROTRANGE — Block Protection Range Address Register
0x37F810 PARTID
