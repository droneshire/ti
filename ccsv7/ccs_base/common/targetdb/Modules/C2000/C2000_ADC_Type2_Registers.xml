# C2000_ADC_Type2_Registers register map
Vendor: Texas Instruments
Peripheral module from a debugger description file (folder C2000).
Address unit: 16 bits
Registers are 16-bit, access not given, no defined reset value unless marked. A register's access mark holds for its fields unless they carry their own. Offsets are as the file gives them; lines under a group give offsets from that group; [hi:lo] are bit positions; {n}, {i} and the like mark numbered series; 'fields as' and 'values as' point back to an identical list; <NAME> marks a mode.

## ADC — ADC Registers
0x00 ADCTRL1 — ADC Control Register 1
0x01 ADCTRL2 — ADC Control Register 2
0x02 ADCMAXCONV — ADC Maximum Conversion Channels Register
{0x2+i} ADCCHSELSEQ{i} (i=1..4) — ADC Channel Select Sequencing Control Register {i}
0x07 ADCASEQSR — ADC Auto-Sequence Status Register
{0x8+i} ADCRESULT{i} (i=0..15) — ADC Conversion Result Buffer Register {i}
0x18 ADCTRL3 — ADC Control Register 3
0x19 ADCST — ADC Status Register
0x1C ADCREFSEL — ADC Reference Select Register
0x1D ADCOFFTRIM — ADC Offset Trim Register
