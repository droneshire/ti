# C2000_ePWM1_Type1_Registers register map
Vendor: Texas Instruments
Peripheral module from a debugger description file (folder C2000).
Address unit: 16 bits
Registers are 16-bit, access not given, no defined reset value unless marked. A register's access mark holds for its fields unless they carry their own. Offsets are as the file gives them; lines under a group give offsets from that group; [hi:lo] are bit positions; {n}, {i} and the like mark numbered series; 'fields as' and 'values as' point back to an identical list; <NAME> marks a mode.

## EPWM — EPWM1 Registers
0x00 TBCTL — Time Base Control Register
0x01 TBSTS — Time Base Status Register
0x02 TBPHS 32-bit — Union of TBPHS:TBPHSHR
0x04 TBCTR — Time Base Counter
0x05 TBPRD — Time Base Period register set
0x06 TBPRDHR — Time Base Period High Res Register
0x07 CMPCTL — Compare control
0x08 CMPA 32-bit — Union of CMPA:CMPAHR
0x0A CMPB — Compare B reg
0x0B AQCTLA — Action qual output A
0x0C AQCTLB — Action qual output B
0x0D AQSFRC — Action qual SW force
0x0E AQCSFRC — Action qualifier continuous SW force
0x0F DBCTL — Dead-band control
0x10 DBRED — Dead-band rising edge delay
0x11 DBFED — Dead-band falling edge delay
0x12 TZSEL — Trip zone select
0x13 TZDCSEL — Trip zone digital comparator select
0x14 TZCTL — Trip zone control
0x15 TZEINT — Trip zone interrupt enable
0x16 TZFLG — Trip zone interrupt flags
0x17 TZCLR — Trip zone clear
0x18 TZFRC — Trip zone force interrupt
0x19 ETSEL — Event trigger selection
0x1A ETPS — Event trigger pre-scaler
0x1B ETFLG — Event trigger flags
0x1C ETCLR — Event trigger clear
0x1D ETFRC — Event trigger force
0x1E PCCTL — PWM chopper control
0x20 HRCNFG — HRPWM Config Reg
0x21 HRPWR — HRPWM Power Register - N/A on F2806x devices
0x26 HRMSTEP — HRPWM MEP Step Register
0x28 HRPCTL — High Resolution Period Control
0x2A TBPRDM 32-bit — Union of TBPRD:TBPRDHR mirror registers
0x2C CMPAM 32-bit — Union of CMPA:CMPAHR mirror registers
0x30 DCTRIPSEL — Digital Compare Trip Select
0x31 DCACTL — Digital Compare A Control
0x32 DCBCTL — Digital Compare B Control
0x33 DCFCTL — Digital Compare Filter Control
0x34 DCCAPCTL — Digital Compare Capture Control
0x35 DCFOFFSET — Digital Compare Filter Offset
0x36 DCFOFFSETCNT — Digital Compare Filter Offset Counter
0x37 DCFWINDOW — Digital Compare Filter Window
0x38 DCFWINDOWCNT — Digital Compare Filter Window Counter
0x39 DCCAP — Digital Compare Filter Counter Capture
