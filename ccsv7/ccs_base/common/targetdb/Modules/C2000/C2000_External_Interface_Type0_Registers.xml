# C2000_External_Interface_Type0_Registers register map
Vendor: Texas Instruments
Peripheral module from a debugger description file (folder C2000).
Address unit: 16 bits
Registers are 32-bit, access not given, no defined reset value unless marked. A register's access mark holds for its fields unless they carry their own. Offsets are as the file gives them; lines under a group give offsets from that group; [hi:lo] are bit positions; {n}, {i} and the like mark numbered series; 'fields as' and 'values as' point back to an identical list; <NAME> marks a mode.

## XINTF — XINTF Registers
{0x0+2i} XTIMING{i} (i=0..2)
0x0C XTIMING6
0x0E XTIMING7
0x14 XINTCNF2
0x18 XBANK 16-bit
0x1A XREVISION 16-bit
