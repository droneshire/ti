# C2000_LIN_Type0_Registers register map
Vendor: Texas Instruments
Peripheral module from a debugger description file (folder C2000).
Address unit: 16 bits
Registers are 32-bit, access not given, no defined reset value unless marked. A register's access mark holds for its fields unless they carry their own. Offsets are as the file gives them; lines under a group give offsets from that group; [hi:lo] are bit positions; {n}, {i} and the like mark numbered series; 'fields as' and 'values as' point back to an identical list; <NAME> marks a mode.

## LIN — LIN Registers
{0x0+2i} SCIGCR{i} (i=0..2) — Global Control Register {i}
0x06 SCISETINT — Interrupt Enable Register
0x08 SCICLEARINT — Interrupt Disable Register
0x0A SCISETINTLVL — Set Interrupt Level Register
0x0C SCICLEARINTLVL — Clear Interrupt Level Register
0x0E SCIFLR — Flag Register
0x10 SCIINTVECT0 — Interrupt Vector Offset Register 0
0x12 SCIINTVECT1 — Interrupt Vector Offset Register 1
0x14 SCIFORMAT — Length Control Register
0x16 BRSR — Baud Rate Selection Register
0x18 SCIED — Emulation buffer Register
0x1A SCIRD — Receiver data buffer Register
0x1C SCITD — Transmit data buffer Register
0x22 SCIPIO2 — Pin control Register 2
0x30 LINCOMP — Compare register
0x32 LINRD0 — Receive data register 0
0x34 LINRD1 — Receive data register 1
0x36 LINMASK — Acceptance mask register
0x38 LINID
0x3A LINTD0 — Transmit Data Register 0
0x3C LINTD1 — Transmit Data Register 1
0x3E MBRSR — Baud Rate Selection Register
0x48 IODFTCTRL — IODFT for LIN
