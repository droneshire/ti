# 281x_GPIO_Registers register map
Vendor: Texas Instruments
Peripheral module from a debugger description file (folder C2000).
Address unit: 16 bits
Registers are 16-bit, access not given, no defined reset value unless marked. A register's access mark holds for its fields unless they carry their own. Offsets are as the file gives them; lines under a group give offsets from that group; [hi:lo] are bit positions; {n}, {i} and the like mark numbered series; 'fields as' and 'values as' point back to an identical list; <NAME> marks a mode.

## GPIO — GPIO Registers
0x00 GPAMUX — GPIO A Mux Control Register
0x01 GPADIR — GPIO A Direction Control Register
0x02 GPAQUAL — GPIO A Input Qualification Control Register
0x04 GPBMUX — GPIO B Mux Control Register
0x05 GPBDIR — GPIO B Direction Control Register
0x06 GPBQUAL — GPIO B Input Qualification Control Register
0x0C GPDMUX — GPIO D Mux Control Register
0x0D GPDDIR — GPIO D Direction Control Register
0x0E GPDQUAL — GPIO D Input Qualification Control Register
0x10 GPEMUX — GPIO E Mux Control Register
0x11 GPEDIR — GPIO E Direction Control Register
0x12 GPEQUAL — GPIO E Input Qualification Control Register
0x14 GPFMUX — GPIO F Mux Control Register
0x15 GPFDIR — GPIO F Direction Control Register
0x18 GPGMUX — GPIO G Mux Control Register
0x19 GPGDIR — GPIO G Direction Control Register
0x20 GPADAT — GPIO A Data Register
0x21 GPASET — GPIO A Set Register
0x22 GPACLEAR — GPIO A Clear Register
0x23 GPATOGGLE — GPIO A Toggle Register
0x24 GPBDAT — GPIO B Data Register
0x25 GPBSET — GPIO B Set Register
0x26 GPBCLEAR — GPIO B Clear Register
0x27 GPBTOGGLE — GPIO B Toggle Register
0x2C GPDDAT — GPIO D Data Register
0x2D GPDSET — GPIO D Set Register
0x2E GPDCLEAR — GPIO D Clear Register
0x2F GPDTOGGLE — GPIO D Toggle Register
0x30 GPEDAT — GPIO E Data Register
0x31 GPESET — GPIO E Set Register
0x32 GPECLEAR — GPIO E Clear Register
0x33 GPETOGGLE — GPIO E Toggle Register
0x34 GPFDAT — GPIO F Data Register
0x35 GPFSET — GPIO F Set Register
0x36 GPFCLEAR — GPIO F Clear Register
0x37 GPFTOGGLE — GPIO F Toggle Register
0x38 GPGDAT — GPIO G Data Register
0x39 GPGSET — GPIO G Set Register
0x3A GPGCLEAR — GPIO G Clear Register
0x3B GPGTOGGLE — GPIO G Toggle Register
