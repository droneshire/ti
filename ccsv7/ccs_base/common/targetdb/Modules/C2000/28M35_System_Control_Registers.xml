# 28M35_System_Control_Registers register map
Vendor: Texas Instruments
Peripheral module from a debugger description file (folder C2000).
Address unit: 16 bits
Registers are 16-bit, access not given, no defined reset value unless marked. A register's access mark holds for its fields unless they carry their own. Offsets are as the file gives them; lines under a group give offsets from that group; [hi:lo] are bit positions; {n}, {i} and the like mark numbered series; 'fields as' and 'values as' point back to an identical list; <NAME> marks a mode.

## SYS_CTRL_REGS — SYS CTRL REGS Registers
0x02 CLKCTL — CPU Timer 2 Clock Configuration Register
0x09 PCLKCR2 — Peripheral Clock Control Register2
0x0A HISPCP — High Speed Clock Prescaler
0x0B LOSPCP — Low Speed Clock Prescaler
0x0C PCLKCR0 — Peripheral Clock Control Register0
0x0D PCLKCR1 — Peripheral Clock Control Register1
0x0E LPMCR0 — C28 LPM Control Register0
0x10 PCLKCR3 — Peripheral Clock Control Register3
0x1B CWIR — Control subsystem Wait-in-Reset Register
