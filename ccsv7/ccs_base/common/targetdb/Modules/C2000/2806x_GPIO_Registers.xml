# 2806x_GPIO_Registers register map
Vendor: Texas Instruments
Peripheral module from a debugger description file (folder C2000).
Address unit: 16 bits
Registers are 32-bit, access not given, no defined reset value unless marked. A register's access mark holds for its fields unless they carry their own. Offsets are as the file gives them; lines under a group give offsets from that group; [hi:lo] are bit positions; {n}, {i} and the like mark numbered series; 'fields as' and 'values as' point back to an identical list; <NAME> marks a mode.

## GPIO — GPIO Control Registers
0x00 GPACTRL — GPIO A Control Register (GPIO0 to 31)
0x02 GPAQSEL1 — GPIO A Qualifier Select 1 Register (GPIO0 to 15)
0x04 GPAQSEL2 — GPIO A Qualifier Select 2 Register (GPIO16 to 31)
0x06 GPAMUX1 — GPIO A MUX 1 Register (GPIO0 to 15)
0x08 GPAMUX2 — GPIO A MUX 2 Register (GPIO16 to 31)
0x0A GPADIR — GPIO A Direction Register (GPIO0 to 31)
0x0C GPAPUD — GPIO A Pull Up Disable Register (GPIO0 to 31)
0x0E GPACTRL2 16-bit
0x10 GPBCTRL — GPIO B Control Register (GPIO32 to 44)
0x12 GPBQSEL1 — GPIO B Qualifier Select 1 Register (GPIO32 to 44)
0x14 GPBQSEL2 — GPIO B Qualifier Select 2 Register (GPIO45 to 63)
0x16 GPBMUX1 — GPIO B MUX 1 Register (GPIO32 to 44)
0x18 GPBMUX2 — GPIO B MUX 2 Register (GPIO46 to 63)
0x1A GPBDIR — GPIO B Direction Register (GPIO32 to 44)
0x1C GPBPUD — GPIO B Pull Up Disable Register (GPIO32 to 44)
0x36 AIOMUX1 — Analog I/O MUX1 Register
0x3A AIODIR — Analog I/O Direction Register
0x40 GPADAT — GPIO A Data Register (GPIO0 to 31)
0x42 GPASET — GPIO A Data Set Register (GPIO0 to 31)
0x44 GPACLEAR — GPIO A Data Clear Register (GPIO0 to 31)
0x46 GPATOGGLE — GPIO A Data Toggle Register (GPIO0 to 31)
0x48 GPBDAT — GPIO B Data Register (GPIO32 to 44)
0x4A GPBSET — GPIO B Data Set Register (GPIO32 to 44)
0x4C GPBCLEAR — GPIO B Data Clear Register (GPIO32 to 44)
0x4E GPBTOGGLE — GPIO B Data Toggle Register (GPIO32 to 44)
0x58 AIODAT — Analog I/O Data Register
0x5A AIOSET — Analog I/O Data Set Register
0x5C AIOCLEAR — Analog I/O Data Clear Register
0x5E AIOTOGGLE — Analog I/O Data Toggle Register
{0x5F+i} GPIOXINT{i}SEL 16-bit (i=1..3) — XINT{i} GPIO Input Select Register (GPIO0 to 31)
0x68 GPIOLPMSEL — LPM GPIO Select Register (GPIO0 to 31)
