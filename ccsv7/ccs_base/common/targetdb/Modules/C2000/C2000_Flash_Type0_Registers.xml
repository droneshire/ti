# C2000_Flash_Type0_Registers register map
Vendor: Texas Instruments
Peripheral module from a debugger description file (folder C2000).
Address unit: 16 bits
Registers are 16-bit, access not given, no defined reset value unless marked. A register's access mark holds for its fields unless they carry their own. Offsets are as the file gives them; lines under a group give offsets from that group; [hi:lo] are bit positions; {n}, {i} and the like mark numbered series; 'fields as' and 'values as' point back to an identical list; <NAME> marks a mode.

## FLASH — Flash/OTP Registers
0x00 FOPT — Option Register
0x02 FPWR — Power Modes Register
0x03 FSTATUS — Status Register
0x04 FSTDBYWAIT — Pump/Bank Sleep to Standby Wait State Register
0x05 FACTIVEWAIT — Pump/Bank Standby to Active Wait State Register
0x06 FBANKWAIT — Bank Read Access Wait State Register
0x07 FOTPWAIT — OTP Read Access Wait State Register
