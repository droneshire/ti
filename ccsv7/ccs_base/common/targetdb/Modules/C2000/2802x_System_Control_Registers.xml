# 2802x_System_Control_Registers register map
Vendor: Texas Instruments
Peripheral module from a debugger description file (folder C2000).
Address unit: 16 bits
Registers are 16-bit, access not given, no defined reset value unless marked. A register's access mark holds for its fields unless they carry their own. Offsets are as the file gives them; lines under a group give offsets from that group; [hi:lo] are bit positions; {n}, {i} and the like mark numbered series; 'fields as' and 'values as' point back to an identical list; <NAME> marks a mode.

## SYSCTRL — System Control Registers
0x00 XCLK — 0: XCLKOUT Control
0x01 PLLSTS — 1: PLL Status Register
0x02 CLKCTL — 2: Clock Control Register
0x03 PLLLOCKPRD — 3: PLL Lock Period Register
0x04 INTOSC1TRIM — 4: Internal Oscillator 1 Trim
0x06 INTOSC2TRIM — 6: Internal Oscillator 2 Trim
0x0B LOSPCP — 11: Low-speed peripheral clock pre-scaler
0x0C PCLKCR0 — 12: Peripheral clock control register
0x0D PCLKCR1 — 13: Peripheral clock control register
0x0E LPMCR0 — 14: Low-power mode control register 0
0x10 PCLKCR3 — 16: Peripheral clock register
0x11 PLLCR — 17: PLL control register
0x12 SCSR — 18: System control and status register
0x13 WDCNTR — 19: WD counter register
0x15 WDKEY — 21: WD reset key register
0x19 WDCR — 25: WD timer control register
