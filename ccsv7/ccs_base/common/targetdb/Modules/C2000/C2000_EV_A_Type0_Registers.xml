# C2000_EV_A_Type0_Registers register map
Vendor: Texas Instruments
Peripheral module from a debugger description file (folder C2000).
Address unit: 16 bits
Registers are 16-bit, access not given, no defined reset value unless marked. A register's access mark holds for its fields unless they carry their own. Offsets are as the file gives them; lines under a group give offsets from that group; [hi:lo] are bit positions; {n}, {i} and the like mark numbered series; 'fields as' and 'values as' point back to an identical list; <NAME> marks a mode.

## EVA — EVA Registers
0x00 GPTCONA — 0x7400
0x01 T1CNT — 0x7401
0x02 T1CMPR — 0x7402
0x03 T1PR — 0x7403
0x04 T1CON — 0x7404
0x05 T2CNT — 0x7405
0x06 T2CMPR — 0x7406
0x07 T2PR — 0x7407
0x08 T2CON — 0x7408
0x09 EXTCONA — 0x7409
0x11 COMCONA — 0x7411
0x13 ACTRA — 0x7413
0x15 DBTCONA — 0x7415
{0x16+i} CMPR{i} (i=1..3) — {0x7416+i}
0x20 CAPCONA — 0x7420
0x22 CAPFIFOA — 0x7422
{0x22+i} CAP{i}FIFO (i=1..3) — {0x7422+i}
{0x26+i} CAP{i}FBOT (i=1..3) — {0x7426+i}
0x2C EVAIMRA — 0x742C
0x2D EVAIMRB — 0x742D
0x2E EVAIMRC — 0x742E
0x2F EVAIFRA — 0x742F
0x30 EVAIFRB — 0x7430
0x31 EVAIFRC — 0x7431
