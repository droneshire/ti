# C2000_Flash_Ctrl_Type1_Registers register map
Vendor: Texas Instruments
Peripheral module from a debugger description file (folder C2000).
Address unit: 16 bits
Registers are 32-bit, access not given, no defined reset value unless marked. A register's access mark holds for its fields unless they carry their own. Offsets are as the file gives them; lines under a group give offsets from that group; [hi:lo] are bit positions; {n}, {i} and the like mark numbered series; 'fields as' and 'values as' point back to an identical list; <NAME> marks a mode.

## FLASH_CTRL_REGS — FLASH CTRL REGS Registers
0x00 FRDCNTL — Flash Read Control Register
0x1E FBAC — Flash Bank Access Control Register
0x20 FBFALLBACK — Flash Bank Fallback Power Register
0x22 FBPRDY — Flash Bank Pump Ready Register
0x24 FPAC1 — Flash Pump Access Control Register 1
0x26 FPAC2 — Flash Pump Access Control Register 2
0x28 FMAC — Flash Module Access Control Register
0x2A FMSTAT — Flash Module Status Register
0x17E FRD_INTF_CTRL — Flash Read Interface Control Register
