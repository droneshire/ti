# C2000_M3_GPTM_Type0_Registers register map
Vendor: Texas Instruments
Peripheral module from a debugger description file (folder C2000).
Address unit: 16 bits
Registers are 32-bit, access not given, no defined reset value unless marked. A register's access mark holds for its fields unless they carry their own. Offsets are as the file gives them; lines under a group give offsets from that group; [hi:lo] are bit positions; {n}, {i} and the like mark numbered series; 'fields as' and 'values as' point back to an identical list; <NAME> marks a mode.

## GPTM_REGS — GPTM REGS Registers
0x00 GPTMCFG — GPTM Configuration
0x04 GPTMTAMR — GPTM Timer A Mode
0x08 GPTMTBMR — GPTM Timer B Mode
0x0C GPTMCTL — GPTM Control
0x18 GPTMIMR — GPTM Interrupt Mask
0x1C GPTMRIS — GPTM Raw Interrupt Status
0x20 GPTMMIS — GPTM Masked Interrupt Status
0x24 GPTMICR — GPTM Interrupt Clear
0x28 GPTMTAILR — GPTM Timer A Interval Load
0x2C GPTMTBILR — GPTM Timer B Interval Load
0x30 GPTMTAMATCHR — GPTM Timer A Match
0x34 GPTMTBMATCHR — GPTM Timer B Match
0x38 GPTMTAPR — GPTM Timer A Prescale
0x3C GPTMTBPR — GPTM Timer B Prescale
0x40 GPTMTAPMR — GPTM TimerA Prescale Match
0x44 GPTMTBPMR — GPTM TimerB Prescale Match
0x48 GPTMTAR — GPTM Timer A
0x4C GPTMTBR — GPTM Timer B
0x50 GPTMTAV — GPTM Timer A Value
0x54 GPTMTBV — GPTM Timer B Value
