# C2000_M3_CAN_Type0_Registers register map
Vendor: Texas Instruments
Peripheral module from a debugger description file (folder C2000).
Address unit: 16 bits
Registers are 32-bit, access not given, no defined reset value unless marked. A register's access mark holds for its fields unless they carry their own. Offsets are as the file gives them; lines under a group give offsets from that group; [hi:lo] are bit positions; {n}, {i} and the like mark numbered series; 'fields as' and 'values as' point back to an identical list; <NAME> marks a mode.

## CAN_REGS — CAN REGS Registers
0x00 CAN_CTL — CAN Control Register
0x04 CAN_ES — CAN Error and Status Register
0x08 CAN_ERRC — CAN Error Counter Register
0x0C CAN_BTR — CAN Bit Timing Register
0x10 CAN_INT — CAN Interrupt Register
0x14 CAN_TEST
0x1C CAN_PERR — CAN Parity Error Code Register
0x80 CAN_ABOTR — CAN Auto-bus-on Time Register
0x88 CAN_TXRQ — CAN Transmission Request 2_1 Register
0x9C CAN_NWDAT — CAN New Data 2_1 Register
0xB0 CAN_INTPND — CAN Interrupt Pending 2_1 Register
0xC4 CAN_MSGVAL — CAN Message Valid 2_1 Register
0xD8 CAN_INTMUX — CAN Interrupt Multiplexer 2_1 Register
0x100 CAN_IF1CMD — CAN Interface 1 Command Register
{0xE4+0x20*i} CAN_IF{i}MSK (i=1..3) — CAN Interface {i} Mask Register
{0xE8+0x20*i} CAN_IF{i}ARB (i=1..3) — CAN Interface {i} Arbitration Register
{0xEC+0x20*i} CAN_IF{i}MCTL (i=1..3) — CAN Interface {i} Message Control Register
{0xF0+0x20*i} CAN_IF{i}DATA (i=1..3) — CAN Interface {i} DATA A2_A1 Register
{0xF4+0x20*i} CAN_IF{i}DATB (i=1..3) — CAN Interface {i} DATA B2_B1 Register
0x120 CAN_IF2CMD — CAN Interface 2 Command Register
0x140 CAN_IF3OBS — CAN Interface 3 Observation Register
0x160 CAN_IF3UPD — CAN Interface 3 Update Enable 2_1 Register
