# C2000_28x_IPC_Type0_Registers register map
Vendor: Texas Instruments
Peripheral module from a debugger description file (folder C2000).
Address unit: 16 bits
Registers are 32-bit, access not given, no defined reset value unless marked. A register's access mark holds for its fields unless they carry their own. Offsets are as the file gives them; lines under a group give offsets from that group; [hi:lo] are bit positions; {n}, {i} and the like mark numbered series; 'fields as' and 'values as' point back to an identical list; <NAME> marks a mode.

## CTOM_IPC_REGS — CTOM IPC REGS Registers
0x00 CTOMIPCSET — C28 to M3 core IPC interrupt request set register
0x02 CTOMIPCCLR — C28 to M3 core IPC interrupt request clear register
0x04 CTOMIPCFLG — C28 to M3 core IPC interrupt status register
0x06 MTOCIPCACK — M3 to C28 core IPC interrupt request clear (acknowledge) register
0x08 MTOCIPCSTS — M3 to C28 core IPC interrupt status flag register
0x0C MIPCCOUNTERL — IPC Counter Low Register
0x0E MIPCCOUNTERH — IPC Counter High Register
0x10 CTOMIPCCOM — C28 To M3 IPC Command Register (read/write to C28)
0x12 CTOMIPCADDR — C28 To M3 IPC Address Register (read/write to C28)
0x14 CTOMIPCDATAW — C28 To M3 IPC Data Write Register (read/write to C28)
0x16 CTOMIPCDATAR — C28 To M3 IPC Data Read Register (read only to C28)
0x18 MTOCIPCCOM — M3 To C28 IPC Command Register (read only to C28)
0x1A MTOCIPCADDR — M3 To C28 IPC Address Register (read only to C28)
0x1C MTOCIPCDATAW — M3 To C28 IPC Data Write Register (read only to C28)
0x1E MTOCIPCDATAR — M3 To C28 IPC Data Read Register (read/write to C28)
0x20 CTOMIPCBOOTSTS — IPC Boot Status Register (read only to C28)
0x22 MTOCIPCBOOTMODE — IPC Boot Mode Register (read only to C28)
0x24 CPUMPREQUEST — Flash programming semaphore PUMP request register
0x26 CCLKREQUEST — Clock configuration semaphore C28 request register
