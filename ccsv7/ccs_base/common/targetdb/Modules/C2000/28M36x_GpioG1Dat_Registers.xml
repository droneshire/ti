# 28M36x_GpioG1Dat_Registers register map
Vendor: Texas Instruments
Peripheral module from a debugger description file (folder C2000).
Address unit: 16 bits
Registers are 32-bit, access not given, no defined reset value unless marked. A register's access mark holds for its fields unless they carry their own. Offsets are as the file gives them; lines under a group give offsets from that group; [hi:lo] are bit positions; {n}, {i} and the like mark numbered series; 'fields as' and 'values as' point back to an identical list; <NAME> marks a mode.

## GPIOG1_DATA_REGS — GPIOG1 DATA REGS Registers
0x00 GPEDAT — GPIO E Data Register (GPIO128 to 135)
0x02 GPESET — GPIO E Data Set Register (GPIO128 to 135)
0x04 GPECLEAR — GPIO E Data Clear Register (GPIO128 to 135)
0x06 GPETOGGLE — GPIO E Data Toggle Register (GPIO128 to 135)
0x80 GPADAT — GPIO A Data Register (GPIO0 to 31)
0x82 GPASET — GPIO A Data Set Register (GPIO0 to 31)
0x84 GPACLEAR — GPIO A Data Clear Register (GPIO0 to 31)
0x86 GPATOGGLE — GPIO A Data Toggle Register (GPIO0 to 31)
0x88 GPBDAT — GPIO B Data Register (GPIO32 to 63)
0x8A GPBSET — GPIO B Data Set Register (GPIO32 to 63)
0x8C GPBCLEAR — GPIO B Data Clear Register (GPIO32 to 63)
0x8E GPBTOGGLE — GPIO B Data Toggle Register (GPIO32 to 63)
0x90 GPCDAT — GPIO C Data Register (GPIO68 to 71)
0x92 GPCSET — GPIO C Data Set Register (GPIO68 to 71)
0x94 GPCCLEAR — GPIO C Data Clear Register (GPIO68 to 71)
0x96 GPCTOGGLE — GPIO C Data Toggle Register (GPIO68 to 71)
0x98 GPDDAT — GPIO D Data Register (GPIO96 to 127)
0x9A GPDSET — GPIO D Data Set Register (GPIO96 to 127)
0x9C GPDCLEAR — GPIO D Data Clear Register (GPIO96 to 127)
0x9E GPDTOGGLE — GPIO D Data Toggle Register (GPIO96 to 127)
