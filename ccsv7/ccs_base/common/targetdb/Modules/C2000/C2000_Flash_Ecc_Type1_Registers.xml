# C2000_Flash_Ecc_Type1_Registers register map
Vendor: Texas Instruments
Peripheral module from a debugger description file (folder C2000).
Address unit: 16 bits
Registers are 32-bit, access not given, no defined reset value unless marked. A register's access mark holds for its fields unless they carry their own. Offsets are as the file gives them; lines under a group give offsets from that group; [hi:lo] are bit positions; {n}, {i} and the like mark numbered series; 'fields as' and 'values as' point back to an identical list; <NAME> marks a mode.

## FLASH_ECC_REGS — FLASH ECC REGS Registers
0x00 ECC_ENABLE
0x02 SINGLE_ERR_ADDR — Single Error Address
0x04 UNC_ERR_ADDR — Uncorrectable Error Address
0x06 ERR_STATUS — Error Status
0x08 ERR_POS — Error Position
0x0A ERR_STATUS_CLR — Error Status Clear
0x0C ERR_CNT — Error Control
0x0E ERR_THRESHOLD — Error Threshold
0x10 ERR_INTFLG — Error Interrupt Flag
0x12 ERR_INTCLR — Error Interrupt Flag Clear
0x14 FDATAH_TEST — Data High Test
0x16 FDATAL_TEST — Data Low Test
0x18 FADDR_TEST — ECC Test Address
0x1A FECC_TEST — ECC Test Address
0x1C FECC_CTRL — ECC Control
0x1E FOUTH_TEST — Test Data Out High
0x20 FOUTL_TEST — Test Data Out Low
0x22 FECC_STATUS — ECC Status
