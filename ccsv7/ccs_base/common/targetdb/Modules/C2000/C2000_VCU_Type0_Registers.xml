# C2000_VCU_Type0_Registers register map
Vendor: Texas Instruments
Peripheral module from a debugger description file (folder C2000).
Address unit: 16 bits
Registers are 32-bit, access not given, no defined reset value unless marked. A register's access mark holds for its fields unless they carry their own. Offsets are as the file gives them; lines under a group give offsets from that group; [hi:lo] are bit positions; {n}, {i} and the like mark numbered series; 'fields as' and 'values as' point back to an identical list; <NAME> marks a mode.

## VCU — VCU Registers
{0x0+2i} VR{i} (i=0..8) — General Purpose 32-bit registers
0x12 VT0 — Transition Bit register
0x14 VT1 — Transition Bit register
0x20 VSTATUS — VCU Status Register
0x22 VCRC — CRC Result register for un-secured memories
