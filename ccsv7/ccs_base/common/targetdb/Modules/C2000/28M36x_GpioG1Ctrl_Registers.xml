# 28M36x_GpioG1Ctrl_Registers register map
Vendor: Texas Instruments
Peripheral module from a debugger description file (folder C2000).
Address unit: 16 bits
Registers are 32-bit, access not given, no defined reset value unless marked. A register's access mark holds for its fields unless they carry their own. Offsets are as the file gives them; lines under a group give offsets from that group; [hi:lo] are bit positions; {n}, {i} and the like mark numbered series; 'fields as' and 'values as' point back to an identical list; <NAME> marks a mode.

## GPIOG1_CTRL_REGS — GPIOG1 CTRL REGS Registers
0x00 GPECTRL — GPIO E Control Register (GPIO128 to 135)
0x02 GPEQSEL1 — GPIO E Qualifier Select 2 Register (GPIO128 to 135)
0x06 GPEMUX1 — GPIO E Mux 1 Register (GPIO128 to 135)
0x0A GPEDIR — GPIO E Direction Register (GPIO128 to 135) )
0x80 GPACTRL — GPIO A Control Register (GPIO0 to 31)
0x82 GPAQSEL1 — GPIO A Qualifier Select 2 Register (GPIO0 to 15)
0x84 GPAQSEL2 — GPIO A Qualifier Select 2 Register (GPIO16 to 31)
0x86 GPAMUX1 — GPIO A Mux 1 Register (GPIO0 to 15)
0x88 GPAMUX2 — GPIO A Mux 2 Register (GPIO16 to 31)
0x8A GPADIR — GPIO A Direction Register (GPIO0 to 31) )
0x90 GPBCTRL — GPIO B Control Register (GPIO32 to 63)
0x92 GPBQSEL1 — GPIO B Qualifier Select 1 Register (GPIO32 to 47)
0x94 GPBQSEL2 — GPIO B Qualifier Select 2 Register (GPIO48 to 63)
0x96 GPBMUX1 — GPIO B Mux 1 Register (GPIO32 to 47)
0x98 GPBMUX2 — GPIO B Mux 2 Register (GPIO48 to 63)
0x9A GPBDIR — GPIO B Direction Register (GPIO32 to 63)
0xA0 GPCCTRL — GPIO C Control Register (GPIO64 to 95)
0xA2 GPCQSEL1 — GPIO C Qualifier Select 1 Register (GPIO64 to 79)
0xA4 GPCQSEL2 — GPIO C Qualifier Select 1 Register (GPIO80 to 95)
0xA6 GPCMUX1 — GPIO C Mux 1 Register (GPIO64 to 79)
0xA8 GPCMUX2 — GPIO C Mux 2 Register (GPIO80 to 95)
0xAA GPCDIR — GPIO C Direction Register (GPIO64 to 95)
0xB0 GPDCTRL — GPIO D Control Register (GPIO96 to 127)
0xB2 GPDQSEL1 — GPIO D Qualifier Select 1 Register (GPIO96 to 111)
0xB4 GPDQSEL2 — GPIO D Qualifier Select 1 Register (GPIO112 to 127)
0xB6 GPDMUX1 — GPIO D Mux 1 Register (GPIO96 to 111)
0xB8 GPDMUX2 — GPIO D Mux 2 Register (GPIO112 to 127)
0xBA GPDDIR — GPIO D Direction Register (GPIO96 to 127)
