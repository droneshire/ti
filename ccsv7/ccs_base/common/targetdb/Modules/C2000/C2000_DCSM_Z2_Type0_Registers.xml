# C2000_DCSM_Z2_Type0_Registers register map
Vendor: Texas Instruments
Peripheral module from a debugger description file (folder C2000).
Address unit: 16 bits
Registers are 32-bit, access not given, no defined reset value unless marked. A register's access mark holds for its fields unless they carry their own. Offsets are as the file gives them; lines under a group give offsets from that group; [hi:lo] are bit positions; {n}, {i} and the like mark numbered series; 'fields as' and 'values as' point back to an identical list; <NAME> marks a mode.

## DCSM_REGS_Z2 — DCSM REGS Z2 Registers
0x00 Z2_LINKPOINTER — Zone 2 Link Pointer
0x02 Z2_OTPSECLOCK — Zone 2 OTP Secure JTAG lock
0x04 BOOTMODE
{0x10+2i} Z2_CSMKEY{i} (i=0..3) — Zone 2 CSM Key {i}
0x19 Z2_CR 16-bit — Zone 2 CSM Control Register
0x1A Z2_GRABSECTR — Zone 2 Grab Flash Sectors Register
0x1C Z2_GRABRAMR — Zone 2 Grab RAM Blocks Register
0x1E Z2_EXEONLYSECTR — Zone 2 Flash Execute_Only Sector Register
0x20 Z2_EXEONLYRAMR — Zone 2 RAM Execute_Only Block Register
