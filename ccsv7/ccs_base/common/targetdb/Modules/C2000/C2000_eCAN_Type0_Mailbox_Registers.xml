# C2000_eCAN_Type0_Mailbox_Registers register map
Vendor: Texas Instruments
Peripheral module from a debugger description file (folder C2000).
Address unit: 16 bits
Registers are 32-bit, access not given, no defined reset value unless marked. A register's access mark holds for its fields unless they carry their own. Offsets are as the file gives them; lines under a group give offsets from that group; [hi:lo] are bit positions; {n}, {i} and the like mark numbered series; 'fields as' and 'values as' point back to an identical list; <NAME> marks a mode.

## ECAN_MBX_CONTENT — eCAN Mailbox Content
{0x0+8i} MBX{i}_MSGID (i=0..31) — eCAN Mailbox {i} Message Identifier
{0x2+8i} MBX{i}_MSGCTRL (i=0..31) — eCAN Mailbox {i} Message Control
{0x4+8i} MBX{i}_MDL (i=0..31) — eCAN Mailbox {i} Message Data Low
{0x6+8i} MBX{i}_MDH (i=0..31) — eCAN Mailbox {i} Message Data High
