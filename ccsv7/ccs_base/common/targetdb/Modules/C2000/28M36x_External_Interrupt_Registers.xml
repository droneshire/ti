# 28M36x_External_Interrupt_Registers register map
Vendor: Texas Instruments
Peripheral module from a debugger description file (folder C2000).
Address unit: 16 bits
Registers are 16-bit, access not given, no defined reset value unless marked. A register's access mark holds for its fields unless they carry their own. Offsets are as the file gives them; lines under a group give offsets from that group; [hi:lo] are bit positions; {n}, {i} and the like mark numbered series; 'fields as' and 'values as' point back to an identical list; <NAME> marks a mode.

## XINT — External Interrupt Registers
0x00 XINT1CR — XINT1 configuration register
0x01 XINT2CR — XINT2 configuration register
0x02 XINT3CR — XINT3 configuration register
0x08 XINT1CTR — XINT1 counter register
0x09 XINT2CTR — XINT2 counter register
0x09 XINT3CTR — XINT3 counter register
