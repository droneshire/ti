# C2000_M3_SSI_Type0_Registers register map
Vendor: Texas Instruments
Peripheral module from a debugger description file (folder C2000).
Address unit: 16 bits
Registers are 32-bit, access not given, no defined reset value unless marked. A register's access mark holds for its fields unless they carry their own. Offsets are as the file gives them; lines under a group give offsets from that group; [hi:lo] are bit positions; {n}, {i} and the like mark numbered series; 'fields as' and 'values as' point back to an identical list; <NAME> marks a mode.

## SSI_REGS — SSI REGS Registers
0x00 SSICR0 — SSI Control 0
0x04 SSICR1 — SSI Control 1
0x08 SSIDR — SSI Data
0x0C SSISR — SSI Status
0x10 SSICPSR — SSI Clock Prescale
0x14 SSIIM — SSI Interrupt Mask
0x18 SSIRIS — SSI Raw Interrupt Status
0x1C SSIMIS — SSI Masked Interrupt Status
0x20 SSIICR — SSI Interrupt Clear
0x24 SSIDMACTL — SSI DMA Control
{0xFC0+4i} SSIPERIPHID{i} (i=4..7) — SSI Peripheral Identification {i}
{0xFE0+4i} SSIPERIPHID{i} (i=0..3) — SSI Peripheral Identification {i}
{0xFF0+4i} SSIPCELLID{i} (i=0..3) — SSI PrimeCell Identification {i}
