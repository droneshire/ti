# C2000_PIE_Registers register map
Vendor: Texas Instruments
Peripheral module from a debugger description file (folder C2000).
Address unit: 16 bits
Registers are 16-bit, access not given, no defined reset value unless marked. A register's access mark holds for its fields unless they carry their own. Offsets are as the file gives them; lines under a group give offsets from that group; [hi:lo] are bit positions; {n}, {i} and the like mark numbered series; 'fields as' and 'values as' point back to an identical list; <NAME> marks a mode.

## PIE — Peripheral Interrupt Expansion Registers
0x00 PIECTRL — PIE, Control Register
0x01 PIEACK — PIE, Acknowledge Register
{0x0+2i} PIEIER{i} (i=1..12) — PIE, INT{i} Group Enable Register
{0x1+2i} PIEIFR{i} (i=1..12) — PIE, INT{i} Group Flag Register
