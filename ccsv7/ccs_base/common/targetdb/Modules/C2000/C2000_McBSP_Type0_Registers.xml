# C2000_McBSP_Type0_Registers register map
Vendor: Texas Instruments
Peripheral module from a debugger description file (folder C2000).
Address unit: 16 bits
Registers are 16-bit, access not given, no defined reset value unless marked. A register's access mark holds for its fields unless they carry their own. Offsets are as the file gives them; lines under a group give offsets from that group; [hi:lo] are bit positions; {n}, {i} and the like mark numbered series; 'fields as' and 'values as' point back to an identical list; <NAME> marks a mode.

## McBSP — Multi-Channel Buffered Serial Port Registers
0x00 DRR2 — McBSP Data Receive Register 2
0x01 DRR1 — McBSP Data Receive Register 1
0x02 DXR2 — McBSP Data Transmit Register 2
0x03 DXR1 — McBSP Data Transmit Register 1
0x04 SPCR2 — McBSP Serial Port Control Register 2
0x05 SPCR1 — McBSP Serial Port Control Register 1
0x06 RCR2 — McBSP Receive Control Register 2
0x07 RCR1 — McBSP Receive Control Register 1
0x08 XCR2 — McBSP Transmit Control Register 2
0x09 XCR1 — McBSP Transmit Control Register 1
0x0A SRGR2 — McBSP Sample Rate Generator Register 2
0x0B SRGR1 — McBSP Sample Rate Generator Register 1
0x0C MCR2 — McBSP Multichannel Register 2
0x0D MCR1 — McBSP Multichannel Register 1
0x0E RCERA — McBSP Receive Channel Enable Register Partition A
0x0F RCERB — McBSP Receive Channel Enable Register Partition B
0x10 XCERA — McBSP Transmit Channel Enable Register Partition A
0x11 XCERB — McBSP Transmit Channel Enable Register Partition B
0x12 PCR — McBSP Pin Control Register
0x13 RCERC — McBSP Receive Channel Enable Register Partition C
0x14 RCERD — McBSP Receive Channel Enable Register Partition D
0x15 XCERC — McBSP Transmit Channel Enable Register Partition C
0x16 XCERD — McBSP Transmit Channel Enable Register Partition D
0x17 RCERE — McBSP Receive Channel Enable Register Partition E
0x18 RCERF — McBSP Receive Channel Enable Register Partition F
0x19 XCERE — McBSP Transmit Channel Enable Register Partition E
0x1A XCERF — McBSP Transmit Channel Enable Register Partition F
0x1B RCERG — McBSP Receive Channel Enable Register Partition G
0x1C RCERH — McBSP Receive Channel Enable Register Partition H
0x1D XCERG — McBSP Transmit Channel Enable Register Partition G
0x1E XCERH — McBSP Transmit Channel Enable Register Partition H
0x20 MFFTX — McBSP Transmit FIFO register
0x21 MFFRX — McBSP Receive FIFO register
0x22 MFFCT — McBSP FIFO control register
0x23 MFFINT — McBSP Interrupt Enable Register
0x24 MFFST — McBSP Status Register
