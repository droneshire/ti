# C2000_M3_UCRC_Type0_Registers register map
Vendor: Texas Instruments
Peripheral module from a debugger description file (folder C2000).
Address unit: 16 bits
Registers are 32-bit, access not given, no defined reset value unless marked. A register's access mark holds for its fields unless they carry their own. Offsets are as the file gives them; lines under a group give offsets from that group; [hi:lo] are bit positions; {n}, {i} and the like mark numbered series; 'fields as' and 'values as' point back to an identical list; <NAME> marks a mode.

## UCRCREGS — UCRCREGS Registers
0x00 UCRCCONFIG — uCRC Configuration Register
0x04 UCRCCONTROL
0x08 UCRCRES — uCRC Result Register
