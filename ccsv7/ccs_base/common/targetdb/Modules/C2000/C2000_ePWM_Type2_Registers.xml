# C2000_ePWM_Type2_Registers register map
Vendor: Texas Instruments
Peripheral module from a debugger description file (folder C2000).
Address unit: 16 bits
Registers are 16-bit, access not given, no defined reset value unless marked. A register's access mark holds for its fields unless they carry their own. Offsets are as the file gives them; lines under a group give offsets from that group; [hi:lo] are bit positions; {n}, {i} and the like mark numbered series; 'fields as' and 'values as' point back to an identical list; <NAME> marks a mode.

## EPWM_REGS — EPWM REGS Registers
0x00 TBCTL — Time Base Control Register
0x01 TBSTS — Time Base Status Register
0x02 TBPHSHR — Time Base Phase High Resolution Register
0x03 TBPHS — Time Base Phase Register
0x04 TBCTR — Time Base Counter Register
0x05 TBPRD — Time Base Period Register
0x06 TBPRDHR — Time Base Period High Resolution Register
0x07 CMPCTL — Counter Compare Control Register
0x08 CMPAHR — Counter Compare A High Resolution Register
0x09 CMPA — Counter Compare A Register
0x0A CMPB — Counter Compare B Register
0x0B AQCTLA — Action Qualifier Control Register For Output A
0x0C AQCTLB — Action Qualifier Control Register For Output B
0x0D AQSFRC — Action Qualifier Software Force Register
0x0E AQCSFRC — Action Qualifier Continuous S/W Force Register
0x0F DBCTL — Dead-Band Generator Control Register
0x10 DBRED — Dead-Band Generator Rising Edge Delay Count Register
0x11 DBFED — Dead-Band Generator Falling Edge Delay Count Register
0x12 TZSEL — Trip Zone Select Register
0x13 TZDCSEL — Trip Zone Digital Comparator Select Register
0x14 TZCTL — Trip Zone Control Register
0x15 TZEINT — Trip Zone Enable Interrupt Register
0x16 TZFLG — Trip Zone Flag Register
0x17 TZCLR — Trip Zone Clear Register
0x18 TZFRC — Trip Zone Force Register
0x19 ETSEL — Event Trigger Selection Register
0x1A ETPS — Event Trigger Pre-Scale Register
0x1B ETFLG — Event Trigger Flag Register
0x1C ETCLR — Event Trigger Clear Register
0x1D ETFRC — Event Trigger Force Register
0x1E PCCTL — PWM Chopper Control Register
0x20 HRCNFG — HRPWM Configuration Register
0x21 HRPWR — HRPWM Power Register
0x27 HRCNFG2 — HRPWM Configuration 2 Register
0x28 HRPCTL — High Resolution Period Control Register
0x2A TBPRDHRM — Time Base Period High Resolution Mirror Register
0x2B TBPRDM — Time Base Period Mirror Register
0x2C CMPAHRM — Compare A High Resolution Mirror Register
0x2D CMPAM — Compare A Mirror Register
0x30 DCTRIPSEL — Digital Compare Trip Select Register
0x31 DCACTL — Digital Compare A Control Register
0x32 DCBCTL — Digital Compare B Control Register
0x33 DCFCTL — Digital Compare Filter Control Register
0x34 DCCAPCTL — Digital Compare Capture Control Register
0x35 DCFOFFSET — Digital Compare Filter Offset Register
0x36 DCFOFFSETCNT — Digital Compare Filter Offset Counter Register
0x37 DCFWINDOW — Digital Compare Filter Window Register
0x38 DCFWINDOWCNT — Digital Compare Filter Window Counter Register
0x39 DCCAP — Digital Compare Counter Capture Register
0x40 TBCTL2 — Time Base Control Register 2
0x41 CMPCTL2 — Counter Compare Control Register 2
0x47 AQCTLR — Action Qualifier Control Register
0x4A CMPBHR — Compare B High Resolution Register
0x4C DCAHTRIPSEL — Digital Compare AH Trip Select
0x4D DCALTRIPSEL — Digital Compare AL Trip Select
0x4E DCBHTRIPSEL — Digital Compare BH Trip Select
0x4F DCBLTRIPSEL — Digital Compare BL Trip Select
0x50 ETINTPS — Event-Trigger Interrupt Pre-Scale Register
0x51 ETSOCPS — Event-Trigger SOC Pre-Scale Register
0x52 ETCNTINITCTL — Event-Trigger Counter Initialization Control Register
0x53 ETCNTINIT — Event-Trigger Counter Initialization Register
0x5E EPWMXLINK 32-bit
0x60 TBPHSHRM — Time Base Phase High Resolution Mirror Register
0x61 TBPHSM — Time Base Phase Mirror Register
0x62 TBPRDHRM2 — Time Base Period High Resolution Mirror 2 Register
0x63 TBPRDM2 — Time Base Period Mirror 2 Register
0x64 CMPAHRM2 — Counter Compare A High Resolution Mirror 2 Register
0x65 CMPAM2 — Counter Compare A Mirror 2 Register
0x66 CMPBHRM — Counter Compare B Mirror High Resolution Register
0x67 CMPBM — Counter Compare B Mirror Register
0x69 CMPC — Counter Compare C Register
0x6B CMPD — Counter Compare D Register
0x6C DBREDHR — Dead-Band Generator Rising Edge Delay High Resolution Mirror Register
0x6D DBREDM — Dead-Band Generator Rising Edge Delay Count Mirror Register
0x6E DBFEDHR — Dead-Band Generator Falling Edge Delay High Resolution Register
0x6F DBFEDM — Dead-Band Generator Falling Edge Delay Count Register
0x70 ETCLRM — Event Trigger Clear Register
0x71 TZCLRM — Trip Zone Clear Register
0x73 AQCTLAM — Action Qualifier Control Register For Output A
0x74 AQCTLBM — Action Qualifier Control Register For Output B
0x75 AQSFRCM — Action Qualifier Software Force Register
0x76 AQCSFRCM — Action Qualifier Continuous S/W Force Register
