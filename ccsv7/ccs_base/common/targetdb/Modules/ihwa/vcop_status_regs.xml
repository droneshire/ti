# vcop_status_regs register map
Vendor: Texas Instruments
Peripheral module from a debugger description file (folder ihwa).
Address unit: 16 bits
Registers are 32-bit, access not given, no defined reset value unless marked. A register's access mark holds for its fields unless they carry their own. Offsets are as the file gives them; lines under a group give offsets from that group; [hi:lo] are bit positions; {n}, {i} and the like mark numbered series; 'fields as' and 'values as' point back to an identical list; <NAME> marks a mode.

## VCOP_Status_Registers
0x00 vcop_pid — VCOP Peripheral ID
0x04 vcop_ctrl — VCOP Control Register
0x08 vcop_status
0x0C vcop_max_iters — VCOP Max Iteration Count
0x10 vcop_error
0x20 vloop_ptr_dec — VLOOP Pointer (decoding)
0x24 vloop_ptr_exe — VLOOP Pointer (executing)
0x28 param_ptr — Parameter Block Pointer
0x30 i0 16-bit — VRPT Loop Variable (i0)
{0x30+2i} i{i} 16-bit (i=1..4) — VLOOP Loop Variable (i{i})
