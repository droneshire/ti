# vcop_vector_regs register map
Vendor: Texas Instruments
Peripheral module from a debugger description file (folder ihwa).
Address unit: 16 bits
Registers are 40-bit, access not given, no defined reset value unless marked. A register's access mark holds for its fields unless they carry their own. Offsets are as the file gives them; lines under a group give offsets from that group; [hi:lo] are bit positions; {n}, {i} and the like mark numbered series; 'fields as' and 'values as' point back to an identical list; <NAME> marks a mode.

## VCOP_Vector_Registers
{0x0+0x40*i} V{i}_0 (i=0..15) — VCOP Vector Register V{i}[0]
{0x8+0x40*i} V{i}_1 (i=0..15) — VCOP Vector Register V{i}[1]
{0x10+0x40*i} V{i}_2 (i=0..15) — VCOP Vector Register V{i}[2]
{0x18+0x40*i} V{i}_3 (i=0..15) — VCOP Vector Register V{i}[3]
{0x20+0x40*i} V{i}_4 (i=0..15) — VCOP Vector Register V{i}[4]
{0x28+0x40*i} V{i}_5 (i=0..15) — VCOP Vector Register V{i}[5]
{0x30+0x40*i} V{i}_6 (i=0..15) — VCOP Vector Register V{i}[6]
{0x38+0x40*i} V{i}_7 (i=0..15) — VCOP Vector Register V{i}[7]
