# arp32_shadow register map
Vendor: Texas Instruments
Peripheral module from a debugger description file (folder ihwa).
Registers are 32-bit, access not given, no defined reset value unless marked. A register's access mark holds for its fields unless they carry their own. Offsets are as the file gives them; lines under a group give offsets from that group; [hi:lo] are bit positions; {n}, {i} and the like mark numbered series; 'fields as' and 'values as' point back to an identical list; <NAME> marks a mode.

## Shadow — Shadow Registers
{0x0+i} SR{i} (i=0..7) — Shadow R{i}
0x08 SLSA0 — Shadow Loop 0 Start Address
0x09 SLEA0 — Shadow Loop 0 End Address
0x0A SLCNT0 — Shadow Loop 0 Iteration Count
0x0B SLSA1 — Shadow Loop 1 Start Address
0x0C SLEA1 — Shadow Loop 1 End Address
0x0D SLCNT1 — Shadow Loop 1 Iteration Count
0x0E SLCNT0RLD — Shadow Loop 0 Iteration Count Reload
