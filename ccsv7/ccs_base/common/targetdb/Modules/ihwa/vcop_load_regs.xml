# vcop_load_regs register map
Vendor: Texas Instruments
Peripheral module from a debugger description file (folder ihwa).
Address unit: 16 bits
Registers are 32-bit, access not given, no defined reset value unless marked. A register's access mark holds for its fields unless they carry their own. Offsets are as the file gives them; lines under a group give offsets from that group; [hi:lo] are bit positions; {n}, {i} and the like mark numbered series; 'fields as' and 'values as' point back to an identical list; <NAME> marks a mode.

## VCOP_Load_Registers
{0x0+4i} ld_ptr{i} (i=0..7) — LD Memory Address {i}
{0x20+4i} st_ptr{i} (i=0..7) — ST Memory Address {i}
