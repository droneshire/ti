# calc5_target_db register map
Vendor: Texas Instruments
Peripheral module from a debugger description file (folder iva2_arp32).
Address unit: 16 bits
Registers are 32-bit, read-write, reset 0x0 unless marked. A register's access mark holds for its fields unless they carry their own. Offsets are as the file gives them; lines under a group give offsets from that group; [hi:lo] are bit positions; {n}, {i} and the like mark numbered series; 'fields as' and 'values as' point back to an identical list; <NAME> marks a mode.

## DSS (part 1 of 4) — ipxact12_to_ccs_generated
{0x3000+4i} mem__{i}_one_word (i=63..1023)
  [31:0] mem_word
{0x6000+4i} mem__{i}_one_word (i=0..31)
  [31:0] mem_word
