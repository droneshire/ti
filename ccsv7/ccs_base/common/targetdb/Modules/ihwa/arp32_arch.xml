# arp32_arch register map
Vendor: Texas Instruments
Peripheral module from a debugger description file (folder ihwa).
Registers are 32-bit, access not given, no defined reset value unless marked. A register's access mark holds for its fields unless they carry their own. Offsets are as the file gives them; lines under a group give offsets from that group; [hi:lo] are bit positions; {n}, {i} and the like mark numbered series; 'fields as' and 'values as' point back to an identical list; <NAME> marks a mode.

## Arch — Architectural Registers
{0x0+i} R{i} (i=0..7)
